## tree/drivers/kernelsu/Kconfig
```kconfig
menu "KernelSU"

config KSU
	bool "KernelSU function support"
	default y
	help
	  Enable kernel-level root support.

endmenu
```

## tree/security/baseband-guard/Kconfig
```kconfig
menu "Baseband Guard"

config BASEBAND_GUARD
	bool "Baseband Guard support"
	default y
	help
	  Protection mechanisms for baseband interface.

endmenu
```
